## conf/layer.conf
```bitbake
LCONF_VERSION = "7"

BBPATH .= ":${LAYERDIR}"

BBFILES += "${LAYERDIR}/recipes-*/*/*.bb \
            ${LAYERDIR}/recipes-*/*/*.bbappend"

BBFILE_COLLECTIONS += "meta-simpleaudio"
BBFILE_PATTERN_meta-simpleaudio := "^${LAYERDIR}/"
BBFILE_PRIORITY_meta-simpleaudio = "6"

LAYERSERIES_COMPAT_meta-simpleaudio = "scarthgap"
```

## conf/machine/roomplayer-i-ii.conf
```bitbake
MACHINEOVERRIDES = "omapl138-lcdk:"

MACHINE = "roomplayer-i-ii"

require conf/machine/omapl138-lcdk.conf

KERNEL_DEVICETREE_PREFIX = " \
    roomplayer \
    ti/davinci/roomplayer \
"

KERNEL_DEVICETREE = "ti/davinci/roomplayer-i-ii.dtb"

KERNEL_IMAGETYPE = "uImage"

PREFERRED_PROVIDER_virtual/kernel = "linux-ti-staging"

# UBOOT_MACHINE = "am335x_evm_defconfig"

# UBOOT_LOADADDRESS = "0x80008000"
# UBOOT_ENTRYPOINT = "0x80008000"

IMAGE_BOOT_FILES = "uImage-initramfs-${MACHINE};uImage roomplayer-i-ii.dtb rfspart bootargs"

INITRAMFS_IMAGE_BUNDLE = "1"

DEBIAN_ARCH = "armel"
DEBIAN_RELEASE = "trixie"
DEBIAN_MIRROR = "http://deb.debian.org/debian"
```

## conf/machine/roomplayer-plus.conf
```bitbake
MACHINEOVERRIDES := "beaglebone:"

MACHINE = "roomplayer-plus"

require conf/machine/beaglebone.conf

KERNEL_DEVICETREE:bsp-bb_org-6_6 = "ti/omap/roomplayer-plus.dtb"
KERNEL_DEVICETREE:bsp-bb_org-6_12 = "ti/omap/roomplayer-plus.dtb"

KERNEL_IMAGETYPE = "uImage"

PREFERRED_PROVIDER_virtual/kernel = "linux-ti-staging"

UBOOT_MACHINE = "am335x_evm_defconfig"

UBOOT_LOADADDRESS = "0x80008000"
UBOOT_ENTRYPOINT = "0x80008000"

IMAGE_BOOT_FILES = "uImage-initramfs-${MACHINE};uImage roomplayer-plus.dtb rfspart bootargs"

INITRAMFS_IMAGE_BUNDLE = "1"
```

## recipes-core/images/simpleaudio-image.wks
```
part --source bootimg-partition --fstype=vfat --label boot --active --align 4 --fixed-size 50M

part --source rootfs --fstype=ext4 --label root --align 4 --fixed-size 1024M
```
